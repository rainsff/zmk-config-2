## config/west.yml
```yaml
manifest:
  remotes:
    - name: zmkfirmware
      url-base: https://github.com/zmkfirmware
    - name: Nicell
      url-base: https://github.com/Nicell
  projects:
    - name: zmk
      remote: Nicell
      revision: split/idle-interval
      import: app/west.yml
  self:
    path: config
```
